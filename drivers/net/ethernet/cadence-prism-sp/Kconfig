## drivers/net/ethernet/cadence-prism-sp/Kconfig
```kconfig
# SPDX-License-Identifier: GPL-2.0-only
#
# Cadence device configuration
#

config NET_VENDOR_PRISM
	bool "Prism network devices"
	depends on HAS_IOMEM
	default y
	help
	  If you have a network (Ethernet) card belonging to this class, say Y.

	  If unsure, say Y.

	  Note that the answer to this question doesn't directly affect the
	  kernel: saying N will just cause the configurator to skip all the
	  remaining Cadence network card questions. If you say Y, you will be
	  asked for your specific card in the following questions.

if NET_VENDOR_PRISM

config SPGEM
	tristate "Prism SP/GEM support"
	depends on HAS_DMA && COMMON_CLK
	depends on PTP_1588_CLOCK_OPTIONAL
	select PHYLINK
	select CRC32
	help
	  The Prism SP/GEM ethernet interface.

endif # NET_VENDOR_PRISM
```
